## boards/shields/blocky/Kconfig.defconfig
```kconfig
if SHIELD_BLOCKY_MAIN

config ZMK_KEYBOARD_NAME
	default "blocky"

config ZMK_USB
    default y

config ZMK_POINTING
    default y
    
config ZMK_SLEEP
    default y

endif
```

## boards/shields/sakuma/Kconfig.defconfig
```kconfig
if SHIELD_SAKUMA_MAIN

config ZMK_KEYBOARD_NAME
	default "sakuma"

config ZMK_USB
    default y

config ZMK_POINTING
    default y
    
config ZMK_SLEEP
    default y

endif
```
